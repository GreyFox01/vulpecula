// display.cpp - ST7789/ILI9341 driver, fonts, dirty-field rendering, SPI arbitration.
// ---------------------------------------------------------------------------
// This file belongs in Vulpecula/src/ and is compiled as part of the
// Vulpecula sketch. If it has been copied into another sketch folder, Arduino
// will try to build it there - because it compiles EVERY source file in a
// sketch folder - and the error you get points at a missing header rather
// than at the real problem.
// ---------------------------------------------------------------------------
#if !__has_include("vulpecula.h") && !__has_include("pure.h")
#error "Vulpecula module in the wrong folder. It must live in Vulpecula/src/ alongside vulpecula.h. Arduino compiles every source file in a sketch folder, so a copy left anywhere else gets built by mistake. Run test/sketch_hygiene_check.py."
#endif

#include "vulpecula.h"

// SPI BUS ARBITRATION
//
// Three peripherals share this bus - display, touch controller and SD card -
// and they are NOT all driven from the same task. Drawing and touch run on
// the UI task; SD logging runs on the radio pump task, which is higher
// priority and will preempt a half-finished display transaction.
//
// SPI.beginTransaction() alone does not protect against that: it configures
// the bus and, depending on core build options, may not serialise across
// tasks at all. A preempted transfer leaves the display mid-command with CS
// asserted, which shows up as corrupted rows, a frozen panel, or SD writes
// that silently return garbage.
//
// So every SPI user takes this mutex first. It is recursive because the draw
// helpers call each other (draw_text -> draw_char), and it is taken for the
// whole logical operation rather than per byte.
// ---------------------------------------------------------------------------
SemaphoreHandle_t g_spi_mux = NULL;

void spi_mux_init()
{
    if (!g_spi_mux) g_spi_mux = xSemaphoreCreateRecursiveMutex();
}

inline void spi_take()
{
    if (g_spi_mux) xSemaphoreTakeRecursive(g_spi_mux, portMAX_DELAY);
}

inline void spi_give()
{
    if (g_spi_mux) xSemaphoreGiveRecursive(g_spi_mux);
}

// ===========================================================================
// DISPLAY  -  raw ST7789 / ILI9341 over the stock Arduino SPI library.
//
// Written out longhand rather than using TFT_eSPI because upstream TFT_eSPI
// has no ESP32-C5 backend: it needs the vendor's TFT_eSPI_ESP32_C5.c/h files
// dropped into the library folder plus target-guard edits, which in Arduino
// IDE means hand-patching a managed library that gets wiped on update.
//
// This is about 200 lines and depends only on SPI.h, so the sketch stays
// single-file and Arduino IDE works out of the box.
// ===========================================================================

// 16-bit RGB565
#define RGB(r,g,b) ((uint16_t)((((r)&0xF8)<<8) | (((g)&0xFC)<<3) | ((b)>>3)))

SPISettings SPI_LCD(SPI_HZ_LCD, MSBFIRST, SPI_MODE0);
SPISettings SPI_TCH(SPI_HZ_TOUCH, MSBFIRST, SPI_MODE0);

bool g_lcd_ok = false;

// Runtime colour order. Defaults to the compile-time value until the operator
// confirms or corrects it on the self-test screen.
disp_cfg_t g_disp = { PANEL_BGR ? true : false, false };

inline void lcd_cs_low()  { digitalWrite(PIN_LCD_CS, LOW); }
inline void lcd_cs_high() { digitalWrite(PIN_LCD_CS, HIGH); }

void lcd_cmd(uint8_t c)
{
    digitalWrite(PIN_LCD_DC, LOW);
    lcd_cs_low();
    SPI.transfer(c);
    lcd_cs_high();
}

void lcd_data(const uint8_t *d, size_t n)
{
    if (!n) return;
    digitalWrite(PIN_LCD_DC, HIGH);
    lcd_cs_low();
    for (size_t i = 0; i < n; i++) SPI.transfer(d[i]);
    lcd_cs_high();
}

void lcd_cmd_data(uint8_t c, const uint8_t *d, size_t n)
{
    lcd_cmd(c);
    lcd_data(d, n);
}

// MADCTL: rotation plus colour order. Bit 3 is the BGR flag on both panels.
uint8_t madctl_value()
{
#if PANEL_DRIVER == 0     // ST7789
    uint8_t v;
    switch (PANEL_ROT & 3) {
        case 0:  v = 0x00; break;            // 240x320 portrait
        case 1:  v = 0x60; break;            // MV | MX  -> 320x240
        case 2:  v = 0xC0; break;
        default: v = 0xA0; break;            // MV | MY  -> 320x240
    }
#else                     // ILI9341
    uint8_t v;
    switch (PANEL_ROT & 3) {
        case 0:  v = 0x40; break;
        case 1:  v = 0x20; break;
        case 2:  v = 0x80; break;
        default: v = 0xE0; break;
    }
#endif
    if (g_disp.bgr) v |= 0x08;    // bit 3 is the BGR flag on both panels
    return v;
}

// Re-send MADCTL after a colour-order change, so it takes effect without a
// reflash or even a reboot.
void lcd_apply_colour_order(void)
{
    uint8_t mad = madctl_value();
    spi_take();
    SPI.beginTransaction(SPI_LCD);
    lcd_cmd_data(0x36, &mad, 1);
    SPI.endTransaction();
    spi_give();
}

void lcd_init()
{
    pinMode(PIN_LCD_CS, OUTPUT);  lcd_cs_high();
    pinMode(PIN_LCD_DC, OUTPUT);  digitalWrite(PIN_LCD_DC, HIGH);
#if PIN_LCD_RST >= 0
    pinMode(PIN_LCD_RST, OUTPUT);
    digitalWrite(PIN_LCD_RST, LOW);  delay(20);
    digitalWrite(PIN_LCD_RST, HIGH); delay(150);
#endif

    SPI.beginTransaction(SPI_LCD);

    lcd_cmd(0x01); delay(150);            // SWRESET - needed, no reset line
    lcd_cmd(0x11); delay(120);            // SLPOUT

    uint8_t colmod = 0x55;                // 16 bits/pixel
    lcd_cmd_data(0x3A, &colmod, 1);

    uint8_t mad = madctl_value();
    lcd_cmd_data(0x36, &mad, 1);

    // Inversion. The vendor's TFT_eSPI ST7789 init table sends INVON
    // unconditionally, which is exactly why issue #3 reports red rendering as
    // yellow or cyan on this panel. It wants INVOFF.
#if PANEL_INVERT
    lcd_cmd(0x21);                        // INVON
#else
    lcd_cmd(0x20);                        // INVOFF
#endif

#if PANEL_DRIVER == 1
    // ILI9341 wants a power/timing preamble that the ST7789 does not.
    { uint8_t d[] = {0x23};              lcd_cmd_data(0xC0, d, 1); }  // PWCTR1
    { uint8_t d[] = {0x10};              lcd_cmd_data(0xC1, d, 1); }  // PWCTR2
    { uint8_t d[] = {0x3E, 0x28};        lcd_cmd_data(0xC5, d, 2); }  // VMCTR1
    { uint8_t d[] = {0x86};              lcd_cmd_data(0xC7, d, 1); }  // VMCTR2
    { uint8_t d[] = {0x00, 0x18};        lcd_cmd_data(0xB1, d, 2); }  // FRMCTR1
    { uint8_t d[] = {0x08, 0x82, 0x27};  lcd_cmd_data(0xB6, d, 3); }  // DFUNCTR
#endif

    lcd_cmd(0x13); delay(10);             // NORON
    lcd_cmd(0x29); delay(120);            // DISPON

    SPI.endTransaction();

    pinMode(PIN_BL, OUTPUT);
    digitalWrite(PIN_BL, HIGH);
    g_lcd_ok = true;
}

void lcd_set_window(int16_t x, int16_t y, int16_t w, int16_t h)
{
    uint16_t x1 = x, x2 = x + w - 1, y1 = y, y2 = y + h - 1;
    uint8_t b[4];
    b[0] = x1 >> 8; b[1] = x1 & 0xFF; b[2] = x2 >> 8; b[3] = x2 & 0xFF;
    lcd_cmd_data(0x2A, b, 4);                       // CASET
    b[0] = y1 >> 8; b[1] = y1 & 0xFF; b[2] = y2 >> 8; b[3] = y2 & 0xFF;
    lcd_cmd_data(0x2B, b, 4);                       // RASET
    lcd_cmd(0x2C);                                  // RAMWR
}

// Push one colour over a rectangle. Chunked so we are not calling transfer()
// per pixel for a full-screen clear.
void fill_rect(int16_t x, int16_t y, int16_t w, int16_t h, uint16_t col)
{
    if (!g_lcd_ok) return;
    if (x < 0) { w += x; x = 0; }
    if (y < 0) { h += y; y = 0; }
    if (x >= SCR_W || y >= SCR_H || w <= 0 || h <= 0) return;
    if (x + w > SCR_W) w = SCR_W - x;
    if (y + h > SCR_H) h = SCR_H - y;

    static uint8_t buf[128];                        // 64 pixels
    for (int i = 0; i < 64; i++) { buf[i*2] = col >> 8; buf[i*2+1] = col & 0xFF; }

    spi_take();
    SPI.beginTransaction(SPI_LCD);
    lcd_set_window(x, y, w, h);
    digitalWrite(PIN_LCD_DC, HIGH);
    lcd_cs_low();
    uint32_t left = (uint32_t)w * h;
    while (left) {
        uint32_t n = left > 64 ? 64 : left;
        SPI.writeBytes(buf, n * 2);
        left -= n;
    }
    lcd_cs_high();
    SPI.endTransaction();
    spi_give();
}

void fill_screen(uint16_t col) { fill_rect(0, 0, SCR_W, SCR_H, col); }

void draw_hline(int16_t x, int16_t y, int16_t w, uint16_t c)
{ fill_rect(x, y, w, 1, c); }
void draw_vline(int16_t x, int16_t y, int16_t h, uint16_t c)
{ fill_rect(x, y, 1, h, c); }

void draw_rect(int16_t x, int16_t y, int16_t w, int16_t h, uint16_t c)
{
    draw_hline(x, y, w, c);
    draw_hline(x, y + h - 1, w, c);
    draw_vline(x, y, h, c);
    draw_vline(x + w - 1, y, h, c);
}

// ---------------------------------------------------------------------------
// FONTS  -  two sizes, both column-major, bit0 = top row.
//
// Generated from DejaVu Sans Mono REGULAR and verified glyph by glyph.
// The first build of this firmware used the BOLD face, which puts 2px stems
// in a 6px cell and reads as heavy and smeared on this panel. Regular gives
// clean 1px stems at 6x8.
//
// FONT6x8   body text, lists, labels. Used at scale 1 almost everywhere.
// FONT12x16 headings and the big RSSI readout. A real 12x16 face rather than
//           6x8 scaled 2x, which is what made the old readout look blocky.
// ---------------------------------------------------------------------------

const uint8_t FONT6x8[95][6] = {
  {0x00,0x00,0x00,0x00,0x00,0x00}, //  
  {0x00,0x00,0x9E,0xBE,0x00,0x00}, // !
  {0x00,0x00,0x0E,0x0E,0x00,0x00}, // "
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  {0x00,0x10,0x10,0x20,0x20,0x00}, // ~
};

// 12x16: two bytes per column, low byte = rows 0-7, high byte = rows 8-15.
const uint16_t FONT12x16[95][12] = {
  {0x0000,0x0000,0x0000,0x0000,0x0000,0x0000,0x0000,0x0000,0x0000,0x0000,0x0000,0x0000}, //  
  {0x0000,0x0000,0x0000,0x0000,0x0000,0xCFFE,0xCFFE,0x0000,0x0000,0x0000,0x0000,0x0000}, // !
  {0x0000,0x0000,0x0000,0x003E,0x003E,0x0000,0x0000,0x003E,0x003E,0x0000,0x0000,0x0000}, // "
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  {0x0000,0x0600,0x0300,0x0300,0x0300,0x0300,0x0600,0x0600,0x0600,0x0600,0x0300,0x0000}, // ~
};

// Draw one character at integer scale. Glyph is column-major, bit0 = top row.
// Fold to upper case at the single point every glyph passes through, so
// captured strings are covered without touching any call site.
inline char ui_fold(char c)
{
#if UI_ALL_CAPS
    if (c >= 'a' && c <= 'z') return (char)(c - 32);
#endif
    return c;
}

void draw_char(int16_t x, int16_t y, char ch, uint16_t fg, uint16_t bg,
                      uint8_t scale)
{
    if (!g_lcd_ok) return;
    ch = ui_fold(ch);
    if (ch < 32 || ch > 126) ch = '?';
    const uint8_t *g = FONT6x8[ch - 32];

    // Build the glyph into a pixel buffer and push it in one window write -
    // far fewer SPI transactions than per-pixel plotting.
    const int cw = 6 * scale, chh = 8 * scale;
    if (cw * chh > 6 * 8 * 16) return;              // scale cap: 4

    static uint8_t px[6 * 8 * 16 * 2];
    int idx = 0;
    for (int row = 0; row < chh; row++) {
        int sy = row / scale;
        for (int colp = 0; colp < cw; colp++) {
            int sx = colp / scale;
            uint16_t c = ((g[sx] >> sy) & 1) ? fg : bg;
            px[idx++] = c >> 8;
            px[idx++] = c & 0xFF;
        }
    }

    spi_take();
    SPI.beginTransaction(SPI_LCD);
    lcd_set_window(x, y, cw, chh);
    digitalWrite(PIN_LCD_DC, HIGH);
    lcd_cs_low();
    SPI.writeBytes(px, idx);
    lcd_cs_high();
    SPI.endTransaction();
    spi_give();
}

// Body text, always 6x8 at scale 1. No scale parameter and no default
// argument: the Arduino preprocessor injects a prototype for every function,
// and a default argument specified in both the injected prototype and the
// definition is a compile error. Headings use draw_text_12 instead.
void draw_text(int16_t x, int16_t y, const char *s, uint16_t fg, uint16_t bg)
{
    if (!s) return;
    int16_t cx = x;
    spi_take();                     // hold the bus for the whole string
    while (*s) {
        if (cx + 6 > SCR_W) break;
        draw_char(cx, y, *s++, fg, bg, 1);
        cx += 6;
    }
    spi_give();
}

// ---------------------------------------------------------------------------
// 12x16 text. A real face rather than 6x8 scaled up, which is what made the
// first build's readout look blocky. Two bytes per column: low byte rows 0-7,
// high byte rows 8-15.
// ---------------------------------------------------------------------------
void draw_char_12(int16_t x, int16_t y, char ch, uint16_t fg, uint16_t bg)
{
    if (!g_lcd_ok) return;
    ch = ui_fold(ch);
    if (ch < 32 || ch > 126) ch = '?';
    const uint16_t *g = FONT12x16[ch - 32];

    static uint8_t px[12 * 16 * 2];
    int idx = 0;
    for (int row = 0; row < 16; row++)
        for (int col = 0; col < 12; col++) {
            uint16_t c = ((g[col] >> row) & 1) ? fg : bg;
            px[idx++] = c >> 8;
            px[idx++] = c & 0xFF;
        }

    spi_take();
    SPI.beginTransaction(SPI_LCD);
    lcd_set_window(x, y, 12, 16);
    digitalWrite(PIN_LCD_DC, HIGH);
    lcd_cs_low();
    SPI.writeBytes(px, idx);
    lcd_cs_high();
    SPI.endTransaction();
    spi_give();
}

void draw_text_12(int16_t x, int16_t y, const char *s, uint16_t fg, uint16_t bg)
{
    if (!s) return;
    int16_t cx = x;
    spi_take();                     // hold the bus for the whole string
    while (*s) {
        if (cx + 12 > SCR_W) break;
        draw_char_12(cx, y, *s++, fg, bg);
        cx += 12;
    }
    spi_give();
}

void draw_text_12_c(int16_t cx, int16_t y, const char *s, uint16_t fg, uint16_t bg)
{
    int w = (int)strlen(s) * 12;
    draw_text_12((int16_t)(cx - w / 2), y, s, fg, bg);
}

// ---------------------------------------------------------------------------
// FLICKER-FREE FIELDS
//
// The first build cleared a region and repainted it on every frame, 4.5 times
// a second, which is exactly what the operator saw as flicker. The clears
// were never necessary: draw_char already writes background pixels for the
// off-bits of every glyph cell, so text overwrites cleanly in place.
//
// A field therefore:
//   * pads its content to a fixed character width, so a value that gets
//     SHORTER erases its own tail instead of needing a clear
//   * remembers what is currently on the glass and rewrites only the
//     character cells whose content changed
//
// A steady reading costs zero SPI traffic. A changing RSSI costs four or five
// glyph cells. Chrome - banners, labels, button frames, the tab bar - is
// painted once when the screen changes and never touched again.
//
// That last point matters beyond appearance: it cuts SPI traffic by roughly
// an order of magnitude, which reduces contention with SD logging on the
// shared bus.
// ---------------------------------------------------------------------------

void field_init(field_t *f, int16_t x, int16_t y, uint8_t w, uint8_t big,
                       uint16_t fg, uint16_t bg)
{
    f->x = x; f->y = y;
    f->w = (w > sizeof(f->cur) - 1) ? (uint8_t)(sizeof(f->cur) - 1) : w;
    f->big = big;
    f->fg = fg; f->bg = bg;
    memset(f->cur, 0, sizeof(f->cur));
}

// Force the next field_set to repaint everything, e.g. after a screen change
// has wiped the glass underneath.
void field_invalidate(field_t *f)
{
    memset(f->cur, 0, sizeof(f->cur));
}

void field_set_col(field_t *f, const char *s, uint16_t fg)
{
    char want[sizeof(f->cur)];
    uint8_t n = 0;
    while (s && s[n] && n < f->w) { want[n] = s[n]; n++; }
    while (n < f->w) want[n++] = ' ';       // pad: the tail erases itself
    want[n] = 0;

    bool recolour = (fg != f->fg);
    if (recolour) f->fg = fg;

    const int cw = f->big ? 12 : 6;
    for (uint8_t i = 0; i < f->w; i++) {
        if (!recolour && f->cur[i] == want[i]) continue;   // already correct
        if (f->big) draw_char_12((int16_t)(f->x + i * cw), f->y, want[i], f->fg, f->bg);
        else        draw_char((int16_t)(f->x + i * cw), f->y, want[i], f->fg, f->bg, 1);
    }
    memcpy(f->cur, want, (size_t)f->w + 1);
}

void field_set(field_t *f, const char *s)
{
    field_set_col(f, s, f->fg);
}

// A horizontal bar that only ever paints the segment that changed (bar_t is
// declared in the TYPE DEFINITIONS block). Repainting the whole bar every
// frame is the second-biggest flicker source after the full-region clears.
void bar_init(bar_t *b, int16_t x, int16_t y, int16_t w, int16_t h)
{
    b->x = x; b->y = y; b->w = w; b->h = h; b->cur = 0; b->col = C_GREEN;
}

void bar_set(bar_t *b, int16_t fill, uint16_t col)
{
    if (fill < 0) fill = 0;
    if (fill > b->w) fill = b->w;

    if (col != b->col) {
        // Colour changed, so the existing filled part is wrong: repaint it
        // and nothing else.
        b->col = col;
        if (fill) fill_rect(b->x, b->y, fill, b->h, col);
        if (fill < b->cur) fill_rect(b->x + fill, b->y, b->cur - fill, b->h, C_BLACK);
        b->cur = fill;
        return;
    }
    if (fill > b->cur) fill_rect(b->x + b->cur, b->y, fill - b->cur, b->h, col);
    else if (fill < b->cur) fill_rect(b->x + fill, b->y, b->cur - fill, b->h, C_BLACK);
    b->cur = fill;
}

// Centred 6x8, for button labels.
void draw_text_c(int16_t cx, int16_t y, const char *s, uint16_t fg, uint16_t bg)
{
    int w = (int)strlen(s) * 6;
    draw_text((int16_t)(cx - w / 2), y, s, fg, bg);
}

// ---------------------------------------------------------------------------
// Colour-order self-test, and it REQUIRES AN ANSWER.
//
// The previous version drew labelled bars, printed advice about which #define
// to change, waited two seconds and carried on regardless. A panel wired BGR
// therefore ran for an entire development cycle with CONTACT rendering blue
// and NEAR rendering teal - and because a red/blue swap leaves the green bits
// alone, ambient stayed green and nothing looked broken.
//
// So the operator confirms it once and the answer is persisted. Same pattern
// as the touch calibration: measure rather than assume.
// ---------------------------------------------------------------------------
static const rect_t BTN_COL_YES = {  18, 186, 130, 40 };
static const rect_t BTN_COL_NO  = { 172, 186, 130, 40 };

static void draw_colour_test(void)
{
    fill_screen(C_BLACK);
    fill_rect(0,   30, 106, 78, C_RED);
    fill_rect(106, 30, 107, 78, C_GREEN);
    fill_rect(213, 30, 107, 78, C_BLUE);
    draw_text_12(46,  60, "R", C_WHITE, C_RED);
    draw_text_12(152, 60, "G", C_WHITE, C_GREEN);
    draw_text_12(259, 60, "B", C_WHITE, C_BLUE);

    draw_text_12(8, 6, "COLOUR CHECK", C_CYAN, C_BLACK);
    draw_text(6, 116, "Does each bar match its letter?", C_WHITE, C_BLACK);
    draw_text(6, 132, "This sets the colour of every alert:", C_DIM, C_BLACK);
    draw_text(6, 144, "CONTACT is RED, NEAR is AMBER. Wrong,", C_DIM, C_BLACK);
    draw_text(6, 156, "and the worst state looks harmless.", C_DIM, C_BLACK);

    draw_rect(BTN_COL_YES.x, BTN_COL_YES.y, BTN_COL_YES.w, BTN_COL_YES.h, C_GREEN);
    draw_rect(BTN_COL_NO.x,  BTN_COL_NO.y,  BTN_COL_NO.w,  BTN_COL_NO.h,  C_AMBER);
    draw_text_12(BTN_COL_YES.x + 35, BTN_COL_YES.y + 12, "YES", C_GREEN, C_BLACK);
    draw_text_12(BTN_COL_NO.x  + 17, BTN_COL_NO.y  + 12, "SWAP", C_AMBER, C_BLACK);
}

// Returns true once the operator has confirmed. SWAP flips and redraws, so
// the effect is visible immediately rather than after a reflash.
bool lcd_confirm_colour_order(void)
{
    for (int attempt = 0; attempt < 8; attempt++) {
        draw_colour_test();
        uint32_t t0 = millis();
        while ((uint32_t)(millis() - t0) < 60000) {
            uint16_t tx, ty;
            if (touch_read(&tx, &ty)) {
                if (hit(&BTN_COL_YES, tx, ty)) {
                    g_disp.confirmed = true;
                    disp_cfg_save();
                    Serial.printf("[disp] colour order confirmed: %s\n",
                                  g_disp.bgr ? "BGR" : "RGB");
                    return true;
                }
                if (hit(&BTN_COL_NO, tx, ty)) {
                    g_disp.bgr = !g_disp.bgr;
                    lcd_apply_colour_order();
                    Serial.printf("[disp] colour order now %s\n",
                                  g_disp.bgr ? "BGR" : "RGB");
                    delay(300);
                    break;                  // redraw under the new order
                }
            }
            delay(15);
        }
    }
    // Nobody there. Persist what we have rather than asking on every boot,
    // but leave it unconfirmed so SETUP keeps flagging it.
    disp_cfg_save();
    return false;
}
